## Config.in
```kconfig
# Kconfig entry point for the RelicOS external tree.
# external.mk globs package/*/*.mk on its own; the Config.in files must be
# sourced here by hand, one per package.
source "$BR2_EXTERNAL_RELICOS_PATH/package/sdl2-diag/Config.in"
source "$BR2_EXTERNAL_RELICOS_PATH/package/freeimage/Config.in"
source "$BR2_EXTERNAL_RELICOS_PATH/package/emulationstation/Config.in"
source "$BR2_EXTERNAL_RELICOS_PATH/package/es-theme-relicos/Config.in"
source "$BR2_EXTERNAL_RELICOS_PATH/package/relicos-joypad/Config.in"
source "$BR2_EXTERNAL_RELICOS_PATH/package/retroarch/Config.in"
source "$BR2_EXTERNAL_RELICOS_PATH/package/libretro-gambatte/Config.in"
source "$BR2_EXTERNAL_RELICOS_PATH/package/libretro-beetle-ngp/Config.in"
source "$BR2_EXTERNAL_RELICOS_PATH/package/libretro-beetle-pce-fast/Config.in"
source "$BR2_EXTERNAL_RELICOS_PATH/package/libretro-beetle-vb/Config.in"
source "$BR2_EXTERNAL_RELICOS_PATH/package/libretro-beetle-wswan/Config.in"
source "$BR2_EXTERNAL_RELICOS_PATH/package/libretro-fceumm/Config.in"
source "$BR2_EXTERNAL_RELICOS_PATH/package/libretro-genesisplusgx/Config.in"
source "$BR2_EXTERNAL_RELICOS_PATH/package/libretro-mgba/Config.in"
source "$BR2_EXTERNAL_RELICOS_PATH/package/libretro-picodrive/Config.in"
source "$BR2_EXTERNAL_RELICOS_PATH/package/libretro-snes9x2010/Config.in"
source "$BR2_EXTERNAL_RELICOS_PATH/package/libretro-stella/Config.in"
source "$BR2_EXTERNAL_RELICOS_PATH/package/libretro-vecx/Config.in"
source "$BR2_EXTERNAL_RELICOS_PATH/package/fatresize/Config.in"
```

## package/emulationstation/Config.in
```kconfig
config BR2_PACKAGE_EMULATIONSTATION
	bool "emulationstation"
	depends on BR2_INSTALL_LIBSTDCPP
	depends on BR2_PACKAGE_SDL2
	help
	  EmulationStation, the RelicOS frontend (ADR 0005): the
	  batocera-emulationstation lineage via the KNULLI fork, built
	  standalone on SDL2/KMSDRM. Hard dependencies (freeimage, vlc,
	  curl, freetype, rapidjson, sdl2_mixer, alsa-lib) are enabled
	  explicitly in the defconfig; a missing one fails the CMake
	  configure loudly rather than hiding this option.
```

## package/es-theme-carbon/Config.in
```kconfig
config BR2_PACKAGE_ES_THEME_CARBON
	bool "es-theme-carbon"
	help
	  The carbon theme for EmulationStation, installed under
	  /usr/share/emulationstation/themes/.
```

## package/es-theme-relicos/Config.in
```kconfig
config BR2_PACKAGE_ES_THEME_RELICOS
	bool "es-theme-relicos"
	help
	  The RelicOS theme for EmulationStation (github.com/RelicOS/es-theme),
	  installed under /usr/share/emulationstation/themes/relicos -- the
	  only theme on the rootfs, hence the default.
```

## package/fatresize/Config.in
```kconfig
config BR2_PACKAGE_FATRESIZE
	bool "fatresize"
	depends on BR2_PACKAGE_PARTED
	help
	  fatresize: grow (or shrink) a FAT16/FAT32 filesystem in place
	  with libparted's fs-resize library, moving the partition
	  boundary in the same run. RelicOS (M19) uses it once, on the
	  first boot, to grow the user partition RELICOS to the end of
	  whatever card the image was written to. Not in Buildroot
	  upstream; the recipe lives in this external tree.

	  https://github.com/ya-mouse/fatresize
```

## package/libretro-beetle-ngp/Config.in
```kconfig
config BR2_PACKAGE_LIBRETRO_BEETLE_NGP
	bool "libretro-beetle-ngp"
	depends on BR2_INSTALL_LIBSTDCPP
	depends on BR2_PACKAGE_RETROARCH
	help
	  Beetle NeoPop, the libretro Neo Geo Pocket / Pocket Color
	  core (M20). No BIOS. One RelicOS system, `ngp`, covers both
	  machines. Installed as
	  /usr/lib/libretro/mednafen_ngp_libretro.so.
```

## package/libretro-beetle-pce-fast/Config.in
```kconfig
config BR2_PACKAGE_LIBRETRO_BEETLE_PCE_FAST
	bool "libretro-beetle-pce-fast"
	depends on BR2_INSTALL_LIBSTDCPP
	depends on BR2_PACKAGE_RETROARCH
	help
	  Beetle PCE Fast, the libretro PC Engine / TurboGrafx-16
	  core (M20) -- the speed-first Mednafen fork, the KNULLI and
	  batocera default for `pcengine`. HuCard only, no BIOS (the
	  CD-ROM² side needs one and stays out). Installed as
	  /usr/lib/libretro/mednafen_pce_fast_libretro.so.
```

## package/libretro-beetle-vb/Config.in
```kconfig
config BR2_PACKAGE_LIBRETRO_BEETLE_VB
	bool "libretro-beetle-vb"
	depends on BR2_INSTALL_LIBSTDCPP
	depends on BR2_PACKAGE_RETROARCH
	help
	  Beetle VB, the libretro Virtual Boy core (M20). No BIOS.
	  The console is red-on-black by design; the core's 2D mode is
	  what a single screen can show. Installed as
	  /usr/lib/libretro/mednafen_vb_libretro.so.
```

## package/libretro-beetle-wswan/Config.in
```kconfig
config BR2_PACKAGE_LIBRETRO_BEETLE_WSWAN
	bool "libretro-beetle-wswan"
	depends on BR2_PACKAGE_RETROARCH
	help
	  Beetle WonderSwan, the libretro WonderSwan / WonderSwan
	  Color core (M20). No BIOS. One RelicOS system, `wswan`,
	  covers both machines. Installed as
	  /usr/lib/libretro/mednafen_wswan_libretro.so.
```

## package/libretro-fceumm/Config.in
```kconfig
config BR2_PACKAGE_LIBRETRO_FCEUMM
	bool "libretro-fceumm"
	depends on BR2_PACKAGE_RETROARCH
	help
	  FCEUmm, the libretro Nintendo Entertainment System /
	  Famicom core (M20). The KNULLI and batocera default for
	  `nes`; light, no BIOS, and it loads the ROM from memory, so
	  RetroArch can hand it a .zip. Installed as
	  /usr/lib/libretro/fceumm_libretro.so.
```

## package/libretro-gambatte/Config.in
```kconfig
config BR2_PACKAGE_LIBRETRO_GAMBATTE
	bool "libretro-gambatte"
	depends on BR2_INSTALL_LIBSTDCPP
	depends on BR2_PACKAGE_RETROARCH
	help
	  Gambatte, the libretro Game Boy / Game Boy Color core -- the
	  first core of RelicOS (M14): small, C++, no dependencies, no
	  dynamic recompiler. Installed as
	  /usr/lib/libretro/gambatte_libretro.so.
```

## package/libretro-genesisplusgx/Config.in
```kconfig
config BR2_PACKAGE_LIBRETRO_GENESISPLUSGX
	bool "libretro-genesisplusgx"
	depends on BR2_INSTALL_LIBSTDCPP
	depends on BR2_PACKAGE_RETROARCH
	help
	  Genesis Plus GX, the libretro core for the whole 8/16-bit
	  Sega line (M20): one .so serves megadrive, mastersystem,
	  gamegear and sg1000. No BIOS for any of the four. Installed
	  as /usr/lib/libretro/genesis_plus_gx_libretro.so.
```

## package/libretro-mgba/Config.in
```kconfig
config BR2_PACKAGE_LIBRETRO_MGBA
	bool "libretro-mgba"
	depends on BR2_INSTALL_LIBSTDCPP
	depends on BR2_PACKAGE_RETROARCH
	select BR2_PACKAGE_ZLIB
	help
	  mGBA, the libretro Game Boy Advance core (M20) -- the KNULLI
	  and batocera default for `gba`. Built from the full mGBA
	  project with CMake, core target only: no Qt, no SDL, no
	  libzip/libpng (RetroArch extracts archives itself). BIOS
	  optional, the core has a high-level replacement. Installed as
	  /usr/lib/libretro/mgba_libretro.so.
```

## package/libretro-picodrive/Config.in
```kconfig
config BR2_PACKAGE_LIBRETRO_PICODRIVE
	bool "libretro-picodrive"
	depends on BR2_PACKAGE_RETROARCH
	help
	  PicoDrive, the libretro Sega 32X core (M20). Fetched from git
	  with its submodules, built for the aarch64 branch of its
	  Makefile. No BIOS. The 32X is the most demanding system of
	  this milestone on a quad Cortex-A35: the frame rate on the
	  device is the datum that decides whether it stays.
	  Installed as /usr/lib/libretro/picodrive_libretro.so.
```

## package/libretro-snes9x2010/Config.in
```kconfig
config BR2_PACKAGE_LIBRETRO_SNES9X2010
	bool "libretro-snes9x2010"
	depends on BR2_PACKAGE_RETROARCH
	help
	  snes9x2010, the libretro Super Nintendo core kept for
	  weak CPUs (M20) -- the 2010 fork of Snes9x, chosen over
	  current snes9x for the quad Cortex-A35. No BIOS. Installed as
	  /usr/lib/libretro/snes9x2010_libretro.so.
```

## package/libretro-stella/Config.in
```kconfig
config BR2_PACKAGE_LIBRETRO_STELLA
	bool "libretro-stella"
	depends on BR2_INSTALL_LIBSTDCPP
	depends on BR2_PACKAGE_RETROARCH
	help
	  Stella, the libretro Atari 2600 core (M20) -- built from
	  the emulator's own repository, whose libretro port lives in
	  src/os/libretro. No BIOS. Installed as
	  /usr/lib/libretro/stella_libretro.so.
```

## package/libretro-vecx/Config.in
```kconfig
config BR2_PACKAGE_LIBRETRO_VECX
	bool "libretro-vecx"
	depends on BR2_PACKAGE_RETROARCH
	depends on BR2_PACKAGE_HAS_LIBGLES
	help
	  vecx, the libretro Vectrex core (M20). The BIOS is built
	  into the core, so nothing to drop on the card. Draws its
	  vectors through GLES2 (Mesa/Panfrost, M9). Installed as
	  /usr/lib/libretro/vecx_libretro.so.
```

## package/relicos-joypad/Config.in
```kconfig
config BR2_PACKAGE_RELICOS_JOYPAD
	bool "relicos-joypad"
	help
	  RelicOS input fusion daemon (M14). The R36S's gamepad is two
	  evdev devices on mainline drivers (gpio-keys: 17 buttons,
	  adc-joystick: 4 axes) and RetroArch binds one device per port.
	  This daemon grabs both and re-emits every event through one
	  uinput device, "RelicOS Gamepad". Needs CONFIG_INPUT_UINPUT
	  in the kernel (board/r36s/linux.fragment). No dependencies:
	  plain C on the libc.
```

## package/retroarch/Config.in
```kconfig
config BR2_PACKAGE_RETROARCH
	bool "retroarch"
	depends on BR2_INSTALL_LIBSTDCPP
	depends on BR2_PACKAGE_MESA3D_OPENGL_EGL && BR2_PACKAGE_MESA3D_OPENGL_ES
	depends on BR2_PACKAGE_HAS_UDEV
	select BR2_PACKAGE_LIBDRM
	select BR2_PACKAGE_ALSA_LIB
	select BR2_PACKAGE_ZLIB
	select BR2_PACKAGE_FREETYPE
	select BR2_PACKAGE_SDL2
	help
	  RetroArch, the libretro frontend (M14): loads one libretro
	  core (.so) at a time and gives it video (KMS/GBM + EGL on the
	  M9 Mesa/Panfrost stack, no display server), audio (ALSA, the
	  M13 dmix) and input (udev). Built with the RGUI menu only --
	  no assets, no fonts, no networking. The selects name what is
	  already in the defconfig; a missing one fails configure loudly.

comment "retroarch needs mesa3d with EGL+GLES and udev"
	depends on !(BR2_PACKAGE_MESA3D_OPENGL_EGL && BR2_PACKAGE_MESA3D_OPENGL_ES && BR2_PACKAGE_HAS_UDEV)
```

## package/rtl8733bu/Config.in
```kconfig
config BR2_PACKAGE_RTL8733BU
	bool "rtl8733bu (source only: the driver and the Bluetooth firmware)"
	help
	  Everything the Realtek RTL8733BU Wi-Fi + Bluetooth USB module
	  needs that mainline Linux 6.12 lacks (M22): Realtek's vendor
	  Wi-Fi driver (v5.15.12-126, in the ROCKNIX tree that fixed it
	  for 6.12 -- mainline rtw88 has no 8733B), and the two Bluetooth
	  firmware blobs (rtl_bt/rtl8723fu_fw.bin, rtl8723fu_config.bin)
	  that the btrtl patch in patches/linux/0005 asks for and that
	  linux-firmware does not carry.

	  This package builds and installs nothing by itself: it is the
	  download-and-patch step. The kernel extension below copies the
	  driver into the kernel tree (built in, obj-y, house rule: this
	  card has no /lib/modules) and the firmware into the kernel's
	  built-in firmware directory (CONFIG_EXTRA_FIRMWARE).

config BR2_LINUX_KERNEL_EXT_RTL8733BU
	bool "RTL8733BU driver and firmware inside the kernel"
	depends on BR2_LINUX_KERNEL
	select BR2_PACKAGE_RTL8733BU
	help
	  Kernel extension (linux/linux-ext-rtl8733bu.mk): before the
	  kernel is patched, copy the rtl8733bu package's driver to
	  drivers/net/wireless/realtek/rtl8733bu, source its Kconfig and
	  Makefile from the realtek ones, and put the Bluetooth firmware
	  under firmware/rtl_bt/ for CONFIG_EXTRA_FIRMWARE. Then
	  CONFIG_RTL8733BU=y in board/r36s/linux.fragment does the rest.
```

## package/sdl2-diag/Config.in
```kconfig
config BR2_PACKAGE_SDL2_DIAG
	bool "sdl2-diag"
	depends on BR2_PACKAGE_SDL2
	help
	  RelicOS bring-up diagnostic (M10): SDL2 KMSDRM video init +
	  joystick enumeration + raw event dump on stdout (the serial
	  console). Separates "SDL sees the world" from "the ES works".
```
